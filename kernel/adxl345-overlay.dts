/dts-v1/;
/plugin/;

/ {
	compatible = "brcm,bcm2835";

	fragment@0 {
		target = <&i2c_arm>;
		__overlay__ {
			#address-cells = <1>;
			#size-cells = <0>;

			adxl345@53 {
				compatible = "adi,adxl345";
				reg = <0x53>;
			};
		};
	};
};
